## meta-industrial-gateway/conf/layer.conf
```bitbake
# We have a conf and classes directory, add to BBPATH
BBPATH .= ":${LAYERDIR}"

# We have recipes-* directories, add to BBFILES
BBFILES += "${LAYERDIR}/recipes-*/*/*.bb \
            ${LAYERDIR}/recipes-*/*/*.bbappend"

BBFILE_COLLECTIONS += "meta-industrial-gateway"
BBFILE_PATTERN_meta-industrial-gateway = "^${LAYERDIR}/"
BBFILE_PRIORITY_meta-industrial-gateway = "6"

LAYERDEPENDS_meta-industrial-gateway = "core"
LAYERSERIES_COMPAT_meta-industrial-gateway = "scarthgap"
```
